## kernel/serial-sc16is7xx/src/Kconfig
```kconfig
#
# Serial device configuration
#

if TTY

menu "Serial drivers"
	depends on HAS_IOMEM

config SERIAL_CORE
	tristate

config SERIAL_CORE_CONSOLE
	bool

config SERIAL_SC16IS7XX_CORE
        tristate

config SERIAL_SC16IS7XX
        tristate "SC16IS7xx serial support"
        select SERIAL_CORE
        depends on (SPI_MASTER && !I2C) || I2C
        help
          This selects support for SC16IS7xx serial ports.
          Supported ICs are SC16IS740, SC16IS741, SC16IS750, SC16IS752,
          SC16IS760 and SC16IS762. Select supported buses using options below.

config SERIAL_SC16IS7XX_I2C
        bool "SC16IS7xx for I2C interface"
        depends on SERIAL_SC16IS7XX
        depends on I2C
        select SERIAL_SC16IS7XX_CORE if SERIAL_SC16IS7XX
        select REGMAP_I2C if I2C
        default y
        help
          Enable SC16IS7xx driver on I2C bus,
          If required say y, and say n to i2c if not required,
          Enabled by default to support oldconfig.
          You must select at least one bus for the driver to be built.

config SERIAL_SC16IS7XX_SPI
        bool "SC16IS7xx for spi interface"
        depends on SERIAL_SC16IS7XX
        depends on SPI_MASTER
        select SERIAL_SC16IS7XX_CORE if SERIAL_SC16IS7XX
        select REGMAP_SPI if SPI_MASTER
        help
          Enable SC16IS7xx driver on SPI bus,
          If required say y, and say n to spi if not required,
          This is additional support to exsisting driver.
          You must select at least one bus for the driver to be built.

endif # TTY
```
